## br-external/configs/skyzonesteadydigital_flash_defconfig
```kconfig
# Skyzone SteadyDigital flashable image (Artosyn Proxima AR9311, Cortex-A53).
# The NAND kernel carries a small fpvOS recovery that loads the main root from
# bank B's userapp over USB; the updater writes bank B and preserves stock
# bank A. Same board, drivers and receiver as the RAM image.
BR2_aarch64=y
BR2_cortex_a53=y
BR2_FPVOS_BOARD_SKYZONE_STEADYDIGITAL=y
BR2_TOOLCHAIN_BUILDROOT_MUSL=y
BR2_STATIC_LIBS=y
BR2_KERNEL_HEADERS_6_18=y
BR2_TARGET_GENERIC_HOSTNAME="fpvos-steadydigital"
BR2_TARGET_GENERIC_ROOT_PASSWD="root"
BR2_TARGET_GENERIC_ISSUE="fpvOS SteadyDigital (experimental)"
BR2_INIT_BUSYBOX=y
# BR2_TARGET_GENERIC_GETTY is not set
BR2_ROOTFS_OVERLAY="$(BR2_EXTERNAL_FPVOS_PATH)/board/common/ar9311/rootfs-overlay $(BR2_EXTERNAL_FPVOS_PATH)/board/ascent-vrx/rootfs-overlay $(BR2_EXTERNAL_FPVOS_PATH)/board/skyzone-steadydigital/rootfs-overlay"
BR2_ROOTFS_POST_IMAGE_SCRIPT="$(BR2_EXTERNAL_FPVOS_PATH)/board/skyzone-steadydigital/source-post-image.sh"
BR2_PACKAGE_HOST_LZ4=y
BR2_PACKAGE_HOST_UBOOT_TOOLS=y
BR2_PACKAGE_BUSYBOX_CONFIG_FRAGMENT_FILES="$(BR2_EXTERNAL_FPVOS_PATH)/board/common/ar9311/busybox.fragment"
BR2_PACKAGE_DROPBEAR=y
# BR2_PACKAGE_DROPBEAR_CLIENT is not set
BR2_PACKAGE_DROPBEAR_DISABLE_REVERSEDNS=y
BR2_PACKAGE_KESTREL_NATIVE=y
BR2_PACKAGE_AR9311_MMC=y
BR2_PACKAGE_AR9311_MEDIA_TEST=y
BR2_PACKAGE_AR9311_TEMP=y
BR2_PACKAGE_AR9311_FIRMWARE=y
BR2_PACKAGE_AR9311_FIRMWARE_ASCENT_17_5_15=y
BR2_PACKAGE_AR9311_RADIO=y
BR2_PACKAGE_OPEN8030_PROFILE="skyzone-steadydigital.c"
BR2_PACKAGE_OPEN8030_TRANSPORT_SDIO=y
BR2_PACKAGE_OPEN8030_FACTORY_OPTIONAL=y
BR2_PACKAGE_DOSFSTOOLS=y
BR2_PACKAGE_DOSFSTOOLS_FSCK_FAT=y
BR2_PACKAGE_E2FSPROGS=y
# The NAND updater and its embedded recovery (bank B; stock bank A preserved).
BR2_PACKAGE_FPVOS_UPDATE=y
BR2_PACKAGE_FPVOS_UPDATE_SKYZONE_STEADYDIGITAL=y
BR2_PACKAGE_FPVOS_RECOVERY=y
BR2_TARGET_ROOTFS_CPIO=y
BR2_TARGET_ROOTFS_CPIO_GZIP=y
# BR2_TARGET_ROOTFS_TAR is not set
BR2_LINUX_KERNEL=y
BR2_LINUX_KERNEL_CUSTOM_TARBALL=y
BR2_LINUX_KERNEL_CUSTOM_TARBALL_LOCATION="https://cdn.kernel.org/pub/linux/kernel/v6.x/linux-6.18.36.tar.xz"
BR2_LINUX_KERNEL_USE_CUSTOM_CONFIG=y
BR2_LINUX_KERNEL_CUSTOM_CONFIG_FILE="$(BR2_EXTERNAL_FPVOS_PATH)/board/common/ar9311/linux.defconfig"
BR2_LINUX_KERNEL_CONFIG_FRAGMENT_FILES="$(BR2_EXTERNAL_FPVOS_PATH)/board/common/ar9311/linux.fragment $(BR2_EXTERNAL_FPVOS_PATH)/board/skyzone-steadydigital/linux.fragment"
BR2_LINUX_KERNEL_PATCH="$(BR2_EXTERNAL_FPVOS_PATH)/board/common/ar9311/linux-patches"
BR2_LINUX_KERNEL_IMAGE=y
BR2_LINUX_KERNEL_DTS_SUPPORT=y
BR2_LINUX_KERNEL_CUSTOM_DTS_DIR="$(BR2_EXTERNAL_FPVOS_PATH)/board/common/ar9311/dts $(BR2_EXTERNAL_FPVOS_PATH)/board/skyzone-steadydigital/dts"
```

## br-external/package/ar9311-camera-control/Config.in
```kconfig
config BR2_PACKAGE_AR9311_CAMERA_CONTROL
	bool "AR9311 camera controls (SC231AI)"
	depends on BR2_PACKAGE_AR9311_CAPTURE
	depends on BR2_PACKAGE_AR9311_CAMERA
	select BR2_PACKAGE_AR9311_MEDIA_TEST
	help
	  Build Missing-Lynk's AE controller with SC231AI V4L2
	  controls. Uses the board-selected ISP tuning and the
	  capture driver's statistics.
	  Also provides a conservative neutral-selection white-balance
	  controller, enabled by board policy.
```

## br-external/package/ar9311-camera/Config.in
```kconfig
config BR2_PACKAGE_AR9311_CAMERA
	bool "AR9311 source camera bring-up"
	depends on BR2_FPVOS_SOC_AR9311
	depends on BR2_LINUX_KERNEL
	help
	  Build the SC231AI V4L2 sensor driver from source. Currently
	  provides fixed 1080p60 RAW10 sensor control only. CSI/ISP
	  capture and encoder integration are still in development.
	  Requires PM, VIDEO_DEV, MEDIA_CONTROLLER and
	  VIDEO_V4L2_SUBDEV_API.
```

## br-external/package/ar9311-capture/Config.in
```kconfig
config BR2_PACKAGE_AR9311_CAPTURE
	bool "AR9311 source capture and ISP drivers (experimental)"
	depends on BR2_FPVOS_SOC_AR9311
	depends on BR2_LINUX_KERNEL
	help
	  Build shared CSI2, VIF, ISP, CVISP and camera clock drivers.
	  Requires a board media graph, DMA pools and sensor tuning.
	  This is experimental; P1 image quality is not yet validated.
```

## br-external/package/ar9311-ge2d/Config.in
```kconfig
config BR2_PACKAGE_AR9311_GE2D
	bool "AR9311 DMA-BUF video/HUD compositor"
	depends on BR2_FPVOS_BOARD_ASCENT_VRX
	depends on BR2_LINUX_KERNEL
	help
	  Native GE2D memory-to-memory composition for offline HUD video
	  export. Imports planar YUV and ARGB DMA buffers without a vendor
	  media daemon. Requires the GE2D/display resource split in the DT.
```

## br-external/package/ar9311-media-test/Config.in
```kconfig
config BR2_PACKAGE_AR9311_MEDIA_TEST
	bool "AR9311 camera, decoder and HDMI playback tools"
	depends on BR2_aarch64
	help
	  Decode short H.264/HEVC clips into visible I420 frames for
	  comparison against a reference decoder on the host. Also includes
	  a bounded 1080p I420 DMA-BUF playback tool for the Gnd485 DRM driver.
	  Includes YUV420M camera-to-HEVC DMA-BUF validation.
```

## br-external/package/ar9311-radio/Config.in
```kconfig
config BR2_PACKAGE_AR9311_RADIO
	bool "AR9311 SDIO radio"
	depends on BR2_FPVOS_SOC_AR9311
	depends on BR2_LINUX_KERNEL
	depends on BR2_TOOLCHAIN_HAS_THREADS
	depends on BR2_HOSTARCH = "x86_64"
	select BR2_PACKAGE_AR9311_MMC
	select BR2_PACKAGE_AR_LIBRE
	select BR2_PACKAGE_OPEN8030
	help
	  AR8030 radio over the AR9311 SDIO host, using ar_libre and
	  Open8030. Select the board's Open8030 profile and radio
	  config, SDIO transport and ground/station role. Device tree
	  supplies the host wiring, power rails and reset GPIO.
	  Firmware loads into radio RAM; no flash writes.

config BR2_PACKAGE_AR9311_RADIO_CALIBRATION
	bool "Host factory calibration provisioning"
	depends on BR2_PACKAGE_AR9311_RADIO
	select BR2_PACKAGE_JANSSON
	help
	  Validate factory power offsets and merge them into a board radio
	  configuration before loading Open8030. The board supplies paths
	  in /etc/default/ar9311-radio; generated configuration stays in RAM.
```

## br-external/package/ar9311-temp/Config.in
```kconfig
config BR2_PACKAGE_AR9311_TEMP
	bool "AR9311 SoC temperature (hwmon)"
	depends on BR2_FPVOS_SOC_AR9311
	depends on BR2_LINUX_KERNEL
	help
	  The SoC's temperature sensor (device tree "artosyn,protemp")
	  as hwmon temp1_input, named ar9311_temp, for kernels without
	  IIO. kestrel-air reports it to the ground.
```

## br-external/package/ascent-lite-ffs/Config.in
```kconfig
config BR2_PACKAGE_ASCENT_LITE_FFS
	bool "ascent-lite-ffs"
	depends on BR2_LINUX_KERNEL
	help
	  FunctionFS (usb_f_fs.ko) for the Ascent Lite and Lite+, whose
	  stock kernel has the USB gadget's configfs but not FunctionFS:
	  the kernel's own f_fs.c, built as a module against the image's
	  kernel tree (the stock kernel's version and vermagic). fpvOS_usb's
	  bridge mode loads it.
```

## br-external/package/btop/Config.in
```kconfig
config BR2_PACKAGE_BTOP
	bool "btop"
	depends on BR2_INSTALL_LIBSTDCPP
	depends on BR2_TOOLCHAIN_HAS_THREADS
	depends on BR2_TOOLCHAIN_GCC_AT_LEAST_11 # C++20
	depends on BR2_ENABLE_LOCALE
	help
	  Resource monitor: CPU per core, memory, disks, network and
	  processes, in the terminal. Handy over the USB ssh link to see
	  what kestrel, the decoder and the baseband daemon cost.

	  Needs a UTF-8 locale to draw its boxes; the defconfig generates
	  en_US.UTF-8 and /etc/profile.d/locale.sh selects it.

	  https://github.com/aristocratos/btop

comment "btop needs a toolchain w/ C++, threads, gcc >= 11, locale"
	depends on !BR2_INSTALL_LIBSTDCPP || !BR2_TOOLCHAIN_HAS_THREADS || \
		!BR2_TOOLCHAIN_GCC_AT_LEAST_11 || !BR2_ENABLE_LOCALE
```

## br-external/package/fpvos-bootchain/Config.in
```kconfig
config BR2_PACKAGE_FPVOS_BOOTCHAIN
	bool "fpvos-bootchain"
	select BR2_PACKAGE_HOST_DTC
	help
	  The SD card's boot chain, made from the user's own stock
	  firmware (vendor/stock/uboot.img and boot.img, which
	  scripts/extract-vendor.py saves) by boot/mkbootchain.py:
	  a patched U-Boot, the kernel FIT with an SD-card device tree,
	  and the p1 fallback's kernel and device tree. Written to the
	  images directory for boot/mk-sd-image.sh.
```

## br-external/package/fpvos-recovery/Config.in
```kconfig
config BR2_PACKAGE_FPVOS_RECOVERY
	bool "fpvOS built-in NAND recovery environment"
	depends on BR2_aarch64 && BR2_STATIC_LIBS
	depends on BR2_PACKAGE_FPVOS_UPDATE_ASCENT_VRX || BR2_PACKAGE_FPVOS_UPDATE_P1_AIR
	select BR2_PACKAGE_DROPBEAR
	help
	  Build a small independent initramfs into the NAND kernel. It loads
	  and verifies the main fpvOS RAM root from NAND, or provides the USB
	  updater and SSH recovery service without an SD card.
```

## br-external/package/fpvos-update/Config.in
```kconfig
config BR2_PACKAGE_FPVOS_UPDATE
	bool "fpvOS firmware updater"
	depends on BR2_USE_MMU
	depends on BR2_aarch64 || BR2_arm
	help
	  USB CDC transport, bundle verification and update service. Storage,
	  image validation and clean-mode policy come from a board backend.

if BR2_PACKAGE_FPVOS_UPDATE
choice
	prompt "Updater board backend"

config BR2_PACKAGE_FPVOS_UPDATE_ASCENT_VRX
	bool "Ascent VRX NAND (Gnd485, AR9311)"
	depends on BR2_FPVOS_BOARD_ASCENT_VRX
	help
	  Fixed NAND layout, readback and rollback, clean-mode selection and
	  original vendor kernel/DTB restoration for Gnd485.

config BR2_PACKAGE_FPVOS_UPDATE_ASCENT_LITE
	bool "Caddx Ascent Lite / Lite+ (in place of the stock updater)"
	depends on BR2_arm
	help
	  The stock updater's replacement, at its path in the app volume
	  (/usrdata/fpv/ar_fpvhs_upgrade): the vendor's PC tool, the fpvOS
	  Flasher and fpvOS's client flash the bank the unit did not boot
	  from, read it back, then switch to it.

config BR2_PACKAGE_FPVOS_UPDATE_ASCENT_VRX_PRO
	bool "Caddx VRX Pro (serial port only)"
	depends on BR2_aarch64
	help
	  The serial port and its USB modes (with fpvos-usb, bridge mode),
	  no update over USB: the goggle is updated by reflashing its SD
	  card.

config BR2_PACKAGE_FPVOS_UPDATE_P1_AIR
	bool "BETAFPV P1 Air NAND"
	depends on BR2_FPVOS_BOARD_P1_AIR
	help
	  Direct boot with an embedded fpvOS recovery system. Write and
	  verify bank 0 before selecting it; preserve stock bank 1, factory
	  calibration and user settings. Stock clean mode is only an installer.

config BR2_PACKAGE_FPVOS_UPDATE_SKYZONE_STEADYDIGITAL
	bool "Skyzone SteadyDigital NAND (AR9311)"
	depends on BR2_FPVOS_BOARD_SKYZONE_STEADYDIGITAL
	help
	  Direct boot with an embedded fpvOS recovery system, as the P1,
	  but mirrored for this board: write and verify bank B before
	  selecting it; preserve stock bank A, factory calibration and user
	  settings. The receiver is kestrel-gnd.
endchoice
endif
```

## br-external/package/fpvos-usb/Config.in
```kconfig
config BR2_PACKAGE_FPVOS_USB
	bool "fpvos-usb"
	depends on BR2_TOOLCHAIN_HAS_THREADS
	help
	  fpvOS_usb: the USB modes next to the serial port (normal and
	  bridge, where the unit's AR8030 shows up on USB), changed by
	  fpvos-update's receiver. Bridge mode needs FunctionFS in the
	  kernel (CONFIG_USB_CONFIGFS_F_FS).

if BR2_PACKAGE_FPVOS_USB
config BR2_PACKAGE_FPVOS_USB_BOARD
	string "board"
	default "ascent-vrx-pro" if BR2_PACKAGE_FPVOS_UPDATE_ASCENT_VRX_PRO
	default "ascent-lite" if BR2_PACKAGE_FPVOS_UPDATE_ASCENT_LITE
	default "p1-air"
	help
	  The board directory in fpvOS_usb's boards/: its settings and
	  hooks (radio-stop, chip-load). ascent-lite installs the Lite's
	  and the Lite+'s in the app volume (/usrdata/fpv/air/usb).
endif
```
