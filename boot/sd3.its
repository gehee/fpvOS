## boot/sd3.its
```
/dts-v1/;
/ {
	description = "VRX Pro SD FIT (neutralized U-Boot + kernel DTB)";
	#address-cells = <1>;
	images {
		fdt   { data = /incbin/("fdt-sd2.dtb");     type = "flat_dt"; arch = "arm64"; compression = "none"; load = <0xffffff00>; hash { algo = "sha256"; }; };
		kernel{ data = /incbin/("kernel.lz4");       type = "kernel";  arch = "arm64"; os = "linux"; compression = "lz4"; entry = <0xffffff01>; load = <0xffffff01>; hash { algo = "sha256"; }; };
		resource { data = /incbin/("resource-sd.img"); type = "multi"; arch = "arm64"; compression = "none"; hash { algo = "sha256"; }; };
	};
	configurations { default = "conf"; conf { rollback-index = <0x0>; fdt = "fdt"; kernel = "kernel"; multi = "resource"; }; };
};
```

## br-external/Config.in
```kconfig
source "$BR2_EXTERNAL_FPVOS_PATH/board/Config.in"
source "$BR2_EXTERNAL_FPVOS_PATH/package/fpvos-vendor-libs/Config.in"
source "$BR2_EXTERNAL_FPVOS_PATH/package/rockchip-mpp/Config.in"
source "$BR2_EXTERNAL_FPVOS_PATH/package/kestrel/Config.in"
source "$BR2_EXTERNAL_FPVOS_PATH/package/btop/Config.in"
source "$BR2_EXTERNAL_FPVOS_PATH/package/fpvos-bootchain/Config.in"
source "$BR2_EXTERNAL_FPVOS_PATH/package/hi3516cv610-sdk/Config.in"
source "$BR2_EXTERNAL_FPVOS_PATH/package/p1-air-vendor/Config.in"
source "$BR2_EXTERNAL_FPVOS_PATH/package/kestrel-air/Config.in"
source "$BR2_EXTERNAL_FPVOS_PATH/package/air-dropbear/Config.in"
source "$BR2_EXTERNAL_FPVOS_PATH/package/air-busybox/Config.in"
source "$BR2_EXTERNAL_FPVOS_PATH/package/ar-libre/Config.in"
source "$BR2_EXTERNAL_FPVOS_PATH/package/ar9311-mmc/Config.in"
source "$BR2_EXTERNAL_FPVOS_PATH/package/ar9311-media-test/Config.in"
source "$BR2_EXTERNAL_FPVOS_PATH/package/ar9311-camera/Config.in"
source "$BR2_EXTERNAL_FPVOS_PATH/package/ar9311-capture/Config.in"
source "$BR2_EXTERNAL_FPVOS_PATH/package/ar9311-camera-control/Config.in"
source "$BR2_EXTERNAL_FPVOS_PATH/package/ar9311-firmware/Config.in"
source "$BR2_EXTERNAL_FPVOS_PATH/package/ar9311-radio/Config.in"
source "$BR2_EXTERNAL_FPVOS_PATH/package/ar9311-temp/Config.in"
source "$BR2_EXTERNAL_FPVOS_PATH/package/open8030/Config.in"

config BR2_PACKAGE_HOST_LZ4
	bool "host lz4 image compressor"
	help
	  Build the host LZ4 tool for the AR9311 post-image wrapper.
	  The package recipe is provided by Buildroot.
source "$BR2_EXTERNAL_FPVOS_PATH/package/fpvos-update/Config.in"
source "$BR2_EXTERNAL_FPVOS_PATH/package/fpvos-usb/Config.in"
source "$BR2_EXTERNAL_FPVOS_PATH/package/ascent-lite-ffs/Config.in"
source "$BR2_EXTERNAL_FPVOS_PATH/package/fpvos-recovery/Config.in"

source "$BR2_EXTERNAL_FPVOS_PATH/package/p1-air-camera-firmware/Config.in"
source "$BR2_EXTERNAL_FPVOS_PATH/package/p1-air-radio-config/Config.in"

source "$BR2_EXTERNAL_FPVOS_PATH/package/kestrel-native/Config.in"
```

## br-external/board/Config.in
```kconfig
config BR2_FPVOS_SOC_AR9311
	bool "Artosyn AR9311 SoC"
	depends on BR2_aarch64
	help
	  Enable packages for the AR9311 host controllers. Boards
	  still supply their wiring, firmware profiles and storage
	  policy.

config BR2_FPVOS_BOARD_ASCENT_VRX
	bool "Caddx Ascent VRX (Gnd485, AR9311)"
	depends on BR2_aarch64
	select BR2_FPVOS_SOC_AR9311
	help
	  Select Gnd485 board integration, including its NAND
	  partition parser. Other AR9311 boards can reuse
	  board/common/ar9311 without selecting this board's wiring,
	  stock firmware layout or update backend.

config BR2_FPVOS_BOARD_P1_AIR
	bool "BETAFPV P1 Air (AR9311)"
	depends on BR2_aarch64
	select BR2_FPVOS_SOC_AR9311
	help
	  P1 board storage and direct NAND recovery policy. Uses the
	  verified 1.0.44 partition layout and preserves stock bank 1.
```

## br-external/board/common/ar9311/linux.defconfig
```kconfig
CONFIG_LOCALVERSION="-fpvos-ar9311"
# CONFIG_LOCALVERSION_AUTO is not set
CONFIG_EXPERT=y
CONFIG_CC_OPTIMIZE_FOR_SIZE=y
CONFIG_NR_CPUS=2
# CONFIG_COMPAT is not set
# CONFIG_EFI is not set
# CONFIG_ACPI is not set
# CONFIG_NUMA is not set
# CONFIG_CPU_IDLE is not set
# CONFIG_CPU_FREQ is not set
# CONFIG_SUSPEND is not set
# CONFIG_HIBERNATION is not set
CONFIG_MODULES=y
CONFIG_MODULE_UNLOAD=y
CONFIG_MODVERSIONS=y
CONFIG_BLOCK=y
CONFIG_PARTITION_ADVANCED=y
CONFIG_MSDOS_PARTITION=y
CONFIG_EFI_PARTITION=y
CONFIG_NET=y
CONFIG_UNIX=y
CONFIG_PACKET=y
CONFIG_INET=y
# CONFIG_IPV6 is not set
# CONFIG_NETFILTER is not set
# CONFIG_WIRELESS is not set
CONFIG_NETDEVICES=y
# CONFIG_ETHERNET is not set
# CONFIG_WLAN is not set
# CONFIG_PCI is not set
# CONFIG_INPUT is not set
# CONFIG_VT is not set
# CONFIG_LEGACY_PTYS is not set
# CONFIG_DEVMEM is not set
CONFIG_MMC=m
CONFIG_MMC_BLOCK=m
CONFIG_MMC_DW=m
CONFIG_MMC_DW_PLTFM=m
CONFIG_GPIOLIB=y
CONFIG_GPIO_CDEV=y
CONFIG_REGULATOR=y
CONFIG_REGULATOR_GPIO=m
CONFIG_VFAT_FS=m
CONFIG_EXFAT_FS=m
CONFIG_EXT4_FS=m
CONFIG_NLS_CODEPAGE_437=m
CONFIG_NLS_ISO8859_1=m
CONFIG_NLS_UTF8=m
CONFIG_DEBUG_FS=y
CONFIG_SPI=y
CONFIG_SPI_MEM=y
CONFIG_SPI_ARTOSYN_QSPI=y
CONFIG_I2C=y
CONFIG_I2C_CHARDEV=m
CONFIG_I2C_DESIGNWARE_CORE=y
CONFIG_I2C_DESIGNWARE_PLATFORM=y
CONFIG_USB_SUPPORT=y
# CONFIG_USB is not set
CONFIG_USB_GADGET=y
CONFIG_USB_DWC2=y
CONFIG_USB_CONFIGFS=y
CONFIG_USB_CONFIGFS_ECM=y
CONFIG_USB_CONFIGFS_ACM=y
CONFIG_USB_CONFIGFS_F_FS=y
CONFIG_CONFIGFS_FS=y
# CONFIG_SOUND is not set
CONFIG_REGULATOR_FIXED_VOLTAGE=y
CONFIG_MEDIA_SUPPORT=y
CONFIG_MEDIA_SUPPORT_FILTER=y
CONFIG_MEDIA_PLATFORM_SUPPORT=y
CONFIG_VIDEO_DEV=m
CONFIG_V4L_MEM2MEM_DRIVERS=y
CONFIG_VIDEO_WAVE_VPU=m
CONFIG_SRAM=y
CONFIG_TTY=y
CONFIG_UNIX98_PTYS=y
CONFIG_SERIAL_8250=y
CONFIG_SERIAL_8250_CONSOLE=y
CONFIG_SERIAL_8250_NR_UARTS=1
CONFIG_SERIAL_8250_RUNTIME_UARTS=1
CONFIG_SERIAL_8250_DW=y
CONFIG_COMMON_CLK=y
CONFIG_COMMON_CLK_AR9311_MMC=y
CONFIG_ARM_GIC=y
CONFIG_ARM_ARCH_TIMER=y
CONFIG_BINFMT_ELF=y
CONFIG_BINFMT_SCRIPT=y
CONFIG_MULTIUSER=y
CONFIG_FUTEX=y
CONFIG_EPOLL=y
CONFIG_SIGNALFD=y
CONFIG_TIMERFD=y
CONFIG_EVENTFD=y
CONFIG_POSIX_TIMERS=y
CONFIG_DEVTMPFS=y
CONFIG_PROC_FS=y
CONFIG_SYSFS=y
CONFIG_TMPFS=y
CONFIG_IKCONFIG=y
CONFIG_IKCONFIG_PROC=y
CONFIG_PRINTK=y
CONFIG_KALLSYMS=y
CONFIG_LOG_BUF_SHIFT=17
CONFIG_MAGIC_SYSRQ=y
CONFIG_DEBUG_INFO_NONE=y

# Microsecond SPI-NAND status polling must not round to scheduler ticks.
CONFIG_HIGH_RES_TIMERS=y
```

## br-external/configs/ascentvrx_defconfig
```kconfig
# Ascent VRX receiver (Gnd485; Artosyn Proxima AR9311, Cortex-A53).
# Linux 6.18 platform: codec, DRM/HDMI, SDIO radio and NAND recovery/update.
BR2_aarch64=y
BR2_cortex_a53=y
BR2_FPVOS_BOARD_ASCENT_VRX=y
BR2_TOOLCHAIN_BUILDROOT_MUSL=y
BR2_STATIC_LIBS=y
BR2_KERNEL_HEADERS_6_18=y
BR2_TARGET_GENERIC_HOSTNAME="fpvos-ar9311"
BR2_TARGET_GENERIC_ROOT_PASSWD="root"
BR2_TARGET_GENERIC_ISSUE="fpvOS Ascent VRX"
BR2_INIT_BUSYBOX=y
# The board's inittab opens a local shell on ttyS0, preserving the baud rate
# set by the kernel (console=ttyS0,1152000).
# BR2_TARGET_GENERIC_GETTY is not set
BR2_ROOTFS_OVERLAY="$(BR2_EXTERNAL_FPVOS_PATH)/board/common/ar9311/rootfs-overlay $(BR2_EXTERNAL_FPVOS_PATH)/board/ascent-vrx/rootfs-overlay"
BR2_ROOTFS_POST_IMAGE_SCRIPT="$(BR2_EXTERNAL_FPVOS_PATH)/board/ascent-vrx/post-image.sh"
BR2_PACKAGE_HOST_LZ4=y
BR2_PACKAGE_BUSYBOX_CONFIG_FRAGMENT_FILES="$(BR2_EXTERNAL_FPVOS_PATH)/board/common/ar9311/busybox.fragment"
BR2_PACKAGE_DROPBEAR=y
# BR2_PACKAGE_DROPBEAR_CLIENT is not set
BR2_PACKAGE_DROPBEAR_DISABLE_REVERSEDNS=y
BR2_PACKAGE_AR9311_MMC=y
BR2_PACKAGE_AR9311_MEDIA_TEST=y
BR2_PACKAGE_KESTREL_NATIVE=y
BR2_PACKAGE_AR9311_FIRMWARE=y
BR2_PACKAGE_AR9311_FIRMWARE_ASCENT_17_5_15=y
BR2_PACKAGE_AR9311_RADIO=y
BR2_PACKAGE_OPEN8030_PROFILE="$(BR2_EXTERNAL_FPVOS_PATH)/../vendor/open8030/ascent-vrx.c"
BR2_PACKAGE_OPEN8030_TRANSPORT_SDIO=y
BR2_PACKAGE_DOSFSTOOLS=y
BR2_PACKAGE_DOSFSTOOLS_FSCK_FAT=y
BR2_PACKAGE_E2FSPROGS=y
BR2_PACKAGE_MEMTESTER=y
BR2_PACKAGE_FPVOS_UPDATE=y
BR2_PACKAGE_FPVOS_UPDATE_ASCENT_VRX=y
BR2_PACKAGE_FPVOS_RECOVERY=y
BR2_TARGET_ROOTFS_CPIO=y
BR2_TARGET_ROOTFS_CPIO_GZIP=y
BR2_TARGET_ROOTFS_CPIO_UIMAGE=y
# BR2_TARGET_ROOTFS_TAR is not set
BR2_LINUX_KERNEL=y
BR2_LINUX_KERNEL_CUSTOM_TARBALL=y
BR2_LINUX_KERNEL_CUSTOM_TARBALL_LOCATION="https://cdn.kernel.org/pub/linux/kernel/v6.x/linux-6.18.36.tar.xz"
BR2_LINUX_KERNEL_USE_CUSTOM_CONFIG=y
BR2_LINUX_KERNEL_CUSTOM_CONFIG_FILE="$(BR2_EXTERNAL_FPVOS_PATH)/board/common/ar9311/linux.defconfig"
BR2_LINUX_KERNEL_CONFIG_FRAGMENT_FILES="$(BR2_EXTERNAL_FPVOS_PATH)/board/common/ar9311/linux.fragment $(BR2_EXTERNAL_FPVOS_PATH)/board/ascent-vrx/linux.fragment"
BR2_LINUX_KERNEL_PATCH="$(BR2_EXTERNAL_FPVOS_PATH)/board/common/ar9311/linux-patches $(BR2_EXTERNAL_FPVOS_PATH)/board/ascent-vrx/linux-patches"
BR2_LINUX_KERNEL_IMAGE=y
BR2_LINUX_KERNEL_DTS_SUPPORT=y
BR2_LINUX_KERNEL_CUSTOM_DTS_DIR="$(BR2_EXTERNAL_FPVOS_PATH)/board/common/ar9311/dts $(BR2_EXTERNAL_FPVOS_PATH)/board/ascent-vrx/dts"
```

## br-external/configs/p1air_defconfig
```kconfig
# P1 stock-runtime bring-up. Buildroot's rootfs/kernel are not flashed.
BR2_aarch64=y
BR2_cortex_a53=y
BR2_TOOLCHAIN_BUILDROOT_MUSL=y
BR2_KERNEL_HEADERS_6_18=y
BR2_TARGET_GENERIC_HOSTNAME="p1-air"
BR2_TARGET_GENERIC_ISSUE="fpvOS P1 Air stock-runtime development"
BR2_FPVOS_SOC_AR9311=y
BR2_PACKAGE_P1_AIR_VENDOR=y
BR2_PACKAGE_OPEN8030=y
BR2_PACKAGE_OPEN8030_PROFILE_P1_STOCK=y
BR2_PACKAGE_OPEN8030_TRANSPORT_SDIO=y
BR2_PACKAGE_OPEN8030_ROLE_AP=y
BR2_PACKAGE_OPEN8030_FACTORY_OPTIONAL=y
BR2_PACKAGE_OPEN8030_PINS_BEFORE_FACTORY=y
BR2_PACKAGE_OPEN8030_EXPLICIT_IO_DOMAINS=y
BR2_PACKAGE_OPEN8030_SDIO_BLOCK_TRAILER=y
BR2_ROOTFS_OVERLAY="$(BR2_EXTERNAL_FPVOS_PATH)/board/p1-air/rootfs-overlay"
BR2_ROOTFS_POST_IMAGE_SCRIPT="$(BR2_EXTERNAL_FPVOS_PATH)/board/p1-air/post-image.sh"
# BR2_TARGET_ROOTFS_TAR is not set
```

## br-external/configs/p1air_source_defconfig
```kconfig
# Source kernel boots directly from NAND with an independent recovery root.
# Preserve factory calibration and usr_data across updates.
# Factory stays read-only; Kestrel settings use a directory in existing usr_data.
BR2_aarch64=y
BR2_cortex_a53=y
BR2_FPVOS_SOC_AR9311=y
BR2_FPVOS_BOARD_P1_AIR=y
BR2_DOWNLOAD_FORCE_CHECK_HASHES=y
BR2_TOOLCHAIN_BUILDROOT_MUSL=y
BR2_STATIC_LIBS=y
BR2_KERNEL_HEADERS_6_18=y
BR2_TARGET_GENERIC_HOSTNAME="fpvos-p1-air"
BR2_TARGET_GENERIC_ROOT_PASSWD="root"
BR2_TARGET_GENERIC_ISSUE="fpvOS P1 Air source-kernel bring-up (experimental)"
BR2_INIT_BUSYBOX=y
# BR2_TARGET_GENERIC_GETTY is not set
BR2_ROOTFS_OVERLAY="$(BR2_EXTERNAL_FPVOS_PATH)/board/common/ar9311/rootfs-overlay $(BR2_EXTERNAL_FPVOS_PATH)/board/p1-air/source-rootfs-overlay"
BR2_PACKAGE_BUSYBOX_CONFIG_FRAGMENT_FILES="$(BR2_EXTERNAL_FPVOS_PATH)/board/common/ar9311/busybox.fragment $(BR2_EXTERNAL_FPVOS_PATH)/board/p1-air/busybox.fragment"
BR2_PACKAGE_DROPBEAR=y
# BR2_PACKAGE_DROPBEAR_CLIENT is not set
BR2_PACKAGE_DROPBEAR_DISABLE_REVERSEDNS=y
BR2_PACKAGE_AR9311_CAMERA=y
BR2_PACKAGE_AR9311_CAPTURE=y
BR2_PACKAGE_AR9311_CAMERA_CONTROL=y
BR2_PACKAGE_AR9311_MEDIA_TEST=y
BR2_PACKAGE_P1_AIR_CAMERA_FIRMWARE=y
BR2_PACKAGE_AR9311_MMC=y
BR2_TARGET_ROOTFS_CPIO=y
BR2_TARGET_ROOTFS_CPIO_GZIP=y
BR2_TARGET_ROOTFS_CPIO_UIMAGE=y
# BR2_TARGET_ROOTFS_TAR is not set
BR2_LINUX_KERNEL=y
BR2_LINUX_KERNEL_CUSTOM_TARBALL=y
BR2_LINUX_KERNEL_CUSTOM_TARBALL_LOCATION="https://cdn.kernel.org/pub/linux/kernel/v6.x/linux-6.18.36.tar.xz"
BR2_LINUX_KERNEL_USE_CUSTOM_CONFIG=y
BR2_LINUX_KERNEL_CUSTOM_CONFIG_FILE="$(BR2_EXTERNAL_FPVOS_PATH)/board/common/ar9311/linux.defconfig"
BR2_LINUX_KERNEL_CONFIG_FRAGMENT_FILES="$(BR2_EXTERNAL_FPVOS_PATH)/board/common/ar9311/linux.fragment $(BR2_EXTERNAL_FPVOS_PATH)/board/p1-air/linux.fragment"
BR2_LINUX_KERNEL_PATCH="$(BR2_EXTERNAL_FPVOS_PATH)/board/common/ar9311/linux-patches"
BR2_LINUX_KERNEL_IMAGE=y
BR2_LINUX_KERNEL_DTS_SUPPORT=y
BR2_LINUX_KERNEL_CUSTOM_DTS_DIR="$(BR2_EXTERNAL_FPVOS_PATH)/board/common/ar9311/dts $(BR2_EXTERNAL_FPVOS_PATH)/board/p1-air/dts"

# Local Kestrel development checkout until its AR9311 backend is published.
BR2_PACKAGE_KESTREL_AIR=y
BR2_PACKAGE_AR9311_RADIO=y
BR2_PACKAGE_AR9311_TEMP=y
BR2_PACKAGE_OPEN8030=y
BR2_PACKAGE_OPEN8030_PROFILE="betafpv-p1-air.c"
BR2_PACKAGE_OPEN8030_TRANSPORT_SDIO=y
BR2_PACKAGE_OPEN8030_ROLE_AP=y
BR2_PACKAGE_OPEN8030_FACTORY_OPTIONAL=y
BR2_PACKAGE_OPEN8030_PINS_BEFORE_FACTORY=y
BR2_PACKAGE_OPEN8030_EXPLICIT_IO_DOMAINS=y
BR2_PACKAGE_P1_AIR_RADIO_CONFIG=y

BR2_PACKAGE_FPVOS_UPDATE=y
BR2_PACKAGE_FPVOS_UPDATE_P1_AIR=y
BR2_PACKAGE_FPVOS_USB=y
BR2_PACKAGE_FPVOS_USB_BOARD="p1-air"
BR2_ROOTFS_POST_IMAGE_SCRIPT="$(BR2_EXTERNAL_FPVOS_PATH)/board/p1-air/source-post-image.sh"

BR2_PACKAGE_FPVOS_RECOVERY=y
BR2_PACKAGE_HOST_UBOOT_TOOLS=y
BR2_PACKAGE_HOST_LZ4=y
```

## br-external/configs/skyzonesteadydigital_defconfig
```kconfig
# Skyzone SteadyDigital receiver (Artosyn Proxima AR9311, Cortex-A53).
# Linux 6.18 RAM image: codec, DSI to the LT9611 HDMI bridge, SDIO radio, USB.
BR2_aarch64=y
BR2_cortex_a53=y
BR2_FPVOS_BOARD_SKYZONE_STEADYDIGITAL=y
BR2_TOOLCHAIN_BUILDROOT_MUSL=y
BR2_STATIC_LIBS=y
BR2_KERNEL_HEADERS_6_18=y
BR2_TARGET_GENERIC_HOSTNAME="fpvos-steadydigital"
BR2_TARGET_GENERIC_ROOT_PASSWD="root"
BR2_TARGET_GENERIC_ISSUE="fpvOS SteadyDigital (experimental)"
BR2_INIT_BUSYBOX=y
# The board's inittab opens a local shell on ttyS0 at the kernel's baud.
# BR2_TARGET_GENERIC_GETTY is not set
# Receiver services shared with the Ascent VRX, then this board's identity.
BR2_ROOTFS_OVERLAY="$(BR2_EXTERNAL_FPVOS_PATH)/board/common/ar9311/rootfs-overlay $(BR2_EXTERNAL_FPVOS_PATH)/board/ascent-vrx/rootfs-overlay $(BR2_EXTERNAL_FPVOS_PATH)/board/skyzone-steadydigital/rootfs-overlay"
BR2_ROOTFS_POST_IMAGE_SCRIPT="$(BR2_EXTERNAL_FPVOS_PATH)/board/skyzone-steadydigital/post-image.sh"
BR2_PACKAGE_HOST_LZ4=y
BR2_PACKAGE_HOST_UBOOT_TOOLS=y
BR2_PACKAGE_BUSYBOX_CONFIG_FRAGMENT_FILES="$(BR2_EXTERNAL_FPVOS_PATH)/board/common/ar9311/busybox.fragment"
BR2_PACKAGE_DROPBEAR=y
# BR2_PACKAGE_DROPBEAR_CLIENT is not set
BR2_PACKAGE_DROPBEAR_DISABLE_REVERSEDNS=y
BR2_PACKAGE_KESTREL_NATIVE=y
BR2_PACKAGE_AR9311_MMC=y
BR2_PACKAGE_AR9311_MEDIA_TEST=y
BR2_PACKAGE_AR9311_TEMP=y
BR2_PACKAGE_AR9311_FIRMWARE=y
BR2_PACKAGE_AR9311_FIRMWARE_ASCENT_17_5_15=y
BR2_PACKAGE_AR9311_RADIO=y
BR2_PACKAGE_OPEN8030_PROFILE="skyzone-steadydigital.c"
BR2_PACKAGE_OPEN8030_TRANSPORT_SDIO=y
# The board's AR8030 has no factory SPI flash.
BR2_PACKAGE_OPEN8030_FACTORY_OPTIONAL=y
BR2_PACKAGE_DOSFSTOOLS=y
BR2_PACKAGE_DOSFSTOOLS_FSCK_FAT=y
BR2_PACKAGE_E2FSPROGS=y
BR2_PACKAGE_MEMTESTER=y
BR2_TARGET_ROOTFS_CPIO=y
BR2_TARGET_ROOTFS_CPIO_GZIP=y
BR2_TARGET_ROOTFS_CPIO_UIMAGE=y
# BR2_TARGET_ROOTFS_TAR is not set
BR2_LINUX_KERNEL=y
BR2_LINUX_KERNEL_CUSTOM_TARBALL=y
BR2_LINUX_KERNEL_CUSTOM_TARBALL_LOCATION="https://cdn.kernel.org/pub/linux/kernel/v6.x/linux-6.18.36.tar.xz"
BR2_LINUX_KERNEL_USE_CUSTOM_CONFIG=y
BR2_LINUX_KERNEL_CUSTOM_CONFIG_FILE="$(BR2_EXTERNAL_FPVOS_PATH)/board/common/ar9311/linux.defconfig"
BR2_LINUX_KERNEL_CONFIG_FRAGMENT_FILES="$(BR2_EXTERNAL_FPVOS_PATH)/board/common/ar9311/linux.fragment $(BR2_EXTERNAL_FPVOS_PATH)/board/skyzone-steadydigital/linux.fragment"
BR2_LINUX_KERNEL_PATCH="$(BR2_EXTERNAL_FPVOS_PATH)/board/common/ar9311/linux-patches"
BR2_LINUX_KERNEL_IMAGE=y
BR2_LINUX_KERNEL_DTS_SUPPORT=y
BR2_LINUX_KERNEL_CUSTOM_DTS_DIR="$(BR2_EXTERNAL_FPVOS_PATH)/board/common/ar9311/dts $(BR2_EXTERNAL_FPVOS_PATH)/board/skyzone-steadydigital/dts"
```
