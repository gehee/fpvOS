## br-external/package/fpvos-vendor-libs/Config.in
```kconfig
config BR2_PACKAGE_FPVOS_VENDOR_LIBS
	bool "fpvos-vendor-libs"
	depends on BR2_PACKAGE_ROCKCHIP_MALI
	help
	  Install the extracted vendor shared libraries (libmali for this
	  board's actual GPU, libar8030_client, librga) into staging and
	  target. Required to link kestrel.

	  Populate them first with scripts/extract-vendor.py; they come from
	  firmware you own and are not redistributed by fpvOS.
```

## br-external/package/kestrel-air/Config.in
```kconfig
config BR2_PACKAGE_KESTREL_AIR
	bool "kestrel-air"
	depends on BR2_arm || (BR2_aarch64 && BR2_FPVOS_SOC_AR9311)
	select BR2_PACKAGE_HI3516CV610_SDK if BR2_arm
	select BR2_PACKAGE_AR_LIBRE
	help
	  fpvOS air application: shared AR8030 transport and video protocol,
	  with a HiSilicon MPI or AR9311 Linux V4L2 camera backend.

if BR2_PACKAGE_KESTREL_AIR
config BR2_PACKAGE_KESTREL_AIR_AR9311
	bool
	default y if BR2_FPVOS_SOC_AR9311
	select BR2_PACKAGE_AR9311_CAMERA_CONTROL
	select BR2_PACKAGE_AR9311_CAPTURE
endif
```

## br-external/package/kestrel-native/Config.in
```kconfig
config BR2_PACKAGE_KESTREL_NATIVE
	bool "Kestrel native Ascent boot runtime"
	depends on BR2_FPVOS_BOARD_ASCENT_VRX
	help
	  Install a static, read-only Kestrel runtime and boot
	  supervisor.
	  First create the SquashFS image with kestrel-gnd's
	  tools/package_ascent.py, then supply its absolute path as
	  KESTREL_NATIVE_IMAGE when invoking make. The firmware
	  package includes the runtime; no host or SD application
	  install is needed.
```

## br-external/package/kestrel/Config.in
```kconfig
config BR2_PACKAGE_KESTREL
	bool "kestrel"
	depends on BR2_PACKAGE_HAS_LIBEGL
	depends on BR2_PACKAGE_HAS_LIBGLES
	select BR2_PACKAGE_FFMPEG
	select BR2_PACKAGE_CAIRO
	select BR2_PACKAGE_CAIRO_PNG
	select BR2_PACKAGE_LIBDRM
	select BR2_PACKAGE_FREETYPE
	select BR2_PACKAGE_PIXMAN
	select BR2_PACKAGE_LIBPNG
	help
	  kestrel-gnd: the fpvOS ground/goggle FPV application.
```

## br-external/package/open8030/Config.in
```kconfig
config BR2_PACKAGE_OPEN8030
	bool "open8030"
	depends on BR2_HOSTARCH = "x86_64" # prebuilt RISC-V compiler
	select BR2_PACKAGE_OPEN8030_PROFILES
	help
	  Open8030, the open-source firmware for the AR8030 radio
	  chip, built from source with Zephyr and installed next to
	  stock's. The goggle loads it unless kestrel-gnd's RADIO >
	  Radio Firmware says STOCK (ar8030_firmware: 0); the air unit
	  (a Lite or Lite+) when /usrdata/fpv/air/open8030/always
	  exists.

	  The board selects its profile, host transport and radio
	  role. Profiles come from open8030-profiles or an explicit
	  private path.

if BR2_PACKAGE_OPEN8030

config BR2_PACKAGE_OPEN8030_PROFILE_P1_STOCK
	bool "Extract P1 Air profile from stock firmware"
	depends on BR2_aarch64
	select BR2_PACKAGE_P1_AIR_VENDOR
	help
	  Generate the P1 board data from the pinned vendor radio image.
	  Overrides the profile filename below; private-directory overrides
	  still apply for development.

config BR2_PACKAGE_OPEN8030_PROFILE
	string "Board profile source"
	depends on !BR2_PACKAGE_OPEN8030_PROFILE_P1_STOCK
	help
	  Profile filename from open8030-profiles, or an absolute path
	  to a private profile. Set this in the board defconfig. A
	  make-time OPEN8030_PRIVATE_DIR override looks up this
	  profile's basename in that directory instead.

choice
	prompt "Host transport"
	default BR2_PACKAGE_OPEN8030_TRANSPORT_SDIO

config BR2_PACKAGE_OPEN8030_TRANSPORT_SDIO
	bool "SDIO"
	help
	  Keep the firmware's existing active-bus detection. The SDIO
	  host must enumerate the radio before firmware starts.

config BR2_PACKAGE_OPEN8030_TRANSPORT_USB
	bool "USB"
	help
	  Force the firmware's USB transport with AR_FORCE_USB.

endchoice

config BR2_PACKAGE_OPEN8030_ROLE_AP
	bool "Air / access-point role"
	help
	  Build with AR_ROLE_AP. Otherwise build the ground/station
	  role. Air firmware is installed under
	  /usrdata/fpv/air/open8030; ground firmware and its
	  configuration go under /lib/firmware.

config BR2_PACKAGE_OPEN8030_FACTORY_OPTIONAL
	bool "Allow operation without factory data"
	help
	  Build with AR_FACTORY_OPTIONAL. Select only for boards whose
	  profile has been validated without mandatory factory data.

config BR2_PACKAGE_OPEN8030_PINS_BEFORE_FACTORY
	bool "Initialize pins before reading factory storage"
	help
	  Set up the board's pin mux before attempting factory-data access.

config BR2_PACKAGE_OPEN8030_EXPLICIT_IO_DOMAINS
	bool "Apply the profile's explicit I/O voltage domains"
	help
	  Replace the two I/O-domain select bits with the profile value,
	  rather than preserving bootloader-selected bits.

config BR2_PACKAGE_OPEN8030_SDIO_BLOCK_TRAILER
	bool "Stock P1 SDIO block-tail framing"
	depends on BR2_PACKAGE_OPEN8030_TRANSPORT_SDIO
	help
	  Use the DD block trailer expected by P1's stock Linux 4.9
	  artosyn_sdio command transport. This is not the ar_libre wire
	  format; do not enable it with an arlink host driver.

config BR2_PACKAGE_OPEN8030_CONFIG
	string "Ground radio configuration"
	default "bb_config_gnd_open8030.json"
	depends on !BR2_PACKAGE_OPEN8030_ROLE_AP
	help
	  Configuration filename from open8030-profiles, or an
	  absolute path. Installed as open8030.json independently of
	  the input name. OPEN8030_CONFIG_DIR (by default
	  OPEN8030_PRIVATE_DIR) can override the source directory at
	  make time. Air units use their runtime board-specific stock
	  configuration.

config BR2_PACKAGE_OPEN8030_AIR_DEFAULT
	bool "air unit boots on Open8030"
	depends on BR2_PACKAGE_KESTREL_AIR
	depends on BR2_PACKAGE_OPEN8030_ROLE_AP
	help
	  Ship /usrdata/fpv/air/open8030/always, so that a Lite or
	  Lite+ starts its radio on Open8030 from the first boot. The
	  goggle has to run Open8030 too (its default). Remove the
	  file on the unit to go back to stock's firmware.

endif
```

## br-external/package/p1-air-camera-firmware/Config.in
```kconfig
config BR2_PACKAGE_P1_AIR_CAMERA_FIRMWARE
	bool "P1 Air camera firmware and tuning"
	depends on BR2_aarch64
	select BR2_PACKAGE_P1_AIR_VENDOR
	help
	  Extract verified SC231AI ISP tuning and Wave521C encoder
	  microcode from the pinned P1 release. Linux capture and
	  codec drivers remain source-built; vendor media libraries
	  are not installed.
```

## br-external/package/p1-air-radio-config/Config.in
```kconfig
config BR2_PACKAGE_P1_AIR_RADIO_CONFIG
	bool "P1 Air radio configuration"
	depends on BR2_PACKAGE_AR9311_RADIO
	select BR2_PACKAGE_P1_AIR_VENDOR
	select BR2_PACKAGE_AR9311_RADIO_CALIBRATION
	help
	  Extract the pinned stock radio defaults and adapt them for Open8030
	  AP operation. Factory power offsets are merged at runtime; no unit
	  identity, pairing or factory calibration is included in the image.
```

## br-external/package/p1-air-vendor/Config.in
```kconfig
config BR2_PACKAGE_P1_AIR_VENDOR
	bool "P1 Air stock runtime"
	depends on BR2_aarch64
	help
	  Extract the pinned BETAFPV P1 1.0.44 release for a stock-kernel
	  air implementation. Keep vendor boot, kernel, DTB and media
	  components together. This does not install or flash the image.
```

## br-external/package/ps5280/Config.in
```kconfig
config BR2_PACKAGE_PS5280
	bool "ps5280"
	depends on BR2_PACKAGE_KESTREL_AIR
	help
	  Sensor glue for the Ascent GT (board 4861). The PS5280 CMOS
	  driver is linked into the stock air app, so this .so maps
	  /usrdata/fpv/ar_ldyhs_sky and exports g_sns_ps5280_obj.
	  kestrel-air dlopen()s it when it finds that chip. Selected by
	  the GT board only.
```

## br-external/package/rockchip-mpp/Config.in
```kconfig
config BR2_PACKAGE_ROCKCHIP_MPP
	bool "rockchip-mpp"
	depends on BR2_aarch64 || BR2_arm
	depends on BR2_TOOLCHAIN_HAS_THREADS
	select BR2_PACKAGE_LIBDRM
	help
	  Rockchip Media Process Platform - the userspace library for the
	  hardware video encoder/decoder (VPU) found on Rockchip SoCs.
	  Provides librockchip_mpp and the <rockchip/rk_mpi.h> API that
	  kestrel's hardware decode path is built on.

	  Built from source rather than taken from the vendor firmware, so
	  it is not one of the proprietary blobs.

	  https://github.com/rockchip-linux/mpp

comment "rockchip-mpp needs a toolchain w/ threads"
	depends on BR2_aarch64 || BR2_arm
	depends on !BR2_TOOLCHAIN_HAS_THREADS
```
