## br-external/board/Config.in
```kconfig
config BR2_FPVOS_SOC_AR9311
	bool "Artosyn AR9311 SoC"
	depends on BR2_aarch64
	help
	  Enable packages for the AR9311 host controllers. Boards
	  still supply their wiring, firmware profiles and storage
	  policy.

config BR2_FPVOS_BOARD_ASCENT_VRX
	bool "Caddx Ascent VRX (Gnd485, AR9311)"
	depends on BR2_aarch64
	select BR2_FPVOS_SOC_AR9311
	help
	  Select Gnd485 board integration, including its NAND
	  partition parser. Other AR9311 boards can reuse
	  board/common/ar9311 without selecting this board's wiring,
	  stock firmware layout or update backend.

config BR2_FPVOS_BOARD_P1_AIR
	bool "BETAFPV P1 Air (AR9311)"
	depends on BR2_aarch64
	select BR2_FPVOS_SOC_AR9311
	help
	  P1 board storage and direct NAND recovery policy. Uses the
	  verified P1 partition layout; installs on the bank not holding
	  stock (either bank) and preserves the stock bank.

config BR2_FPVOS_BOARD_P1_GOGGLE
	bool "BETAFPV P1 goggles (AR9311)"
	depends on BR2_aarch64
	select BR2_FPVOS_SOC_AR9311
	help
	  P1 goggles. Reuses shared AR9311 drivers with board-specific
	  memory and SD wiring. The defconfig selects the native Kestrel
	  receiver and the NAND updater, which installs on the bank not
	  holding stock (either bank) and preserves the stock bank.

config BR2_FPVOS_BOARD_P1_GND
	bool "BETAFPV P1 ground units: goggles, VRX, Nano VRX (AR9311)"
	depends on BR2_aarch64
	select BR2_FPVOS_SOC_AR9311
	help
	  One image for every BETAFPV P1 ground unit, as stock's common
	  P1_GND firmware (2.1.4) is: one kernel and root filesystem, a
	  device tree per unit (the goggles' panel, the Nano VRX's HDMI
	  bridge), and at boot the unit's own Open8030 radio image and
	  configuration, chosen from its device tree. The P1 A/B flash
	  layout; the updater installs on the bank not holding stock.

config BR2_FPVOS_BOARD_SKYZONE_STEADYDIGITAL
	bool "Skyzone SteadyDigital (AR9311)"
	depends on BR2_aarch64
	select BR2_FPVOS_SOC_AR9311
	help
	  SteadyDigital receiver wiring: SDIO radio, LT9611 HDMI
	  bridge, polled GPIO keys. Uses the stock A/B flash layout;
	  the flash image's updater installs on the bank not holding
	  stock (either bank) and never writes the stock bank or
	  factory data.
```

## br-external/configs/p1gnd_defconfig
```kconfig
# BETAFPV P1 ground units (goggles, Nano VRX): one kernel and root filesystem,
# a device tree and Open8030 radio image per unit; independent NAND recovery
# with the stock bank preserved.
BR2_aarch64=y
BR2_TOOLCHAIN_BUILDROOT_MUSL=y
BR2_KERNEL_HEADERS_6_18=y
BR2_STATIC_LIBS=y
BR2_TARGET_GENERIC_HOSTNAME="fpvos-p1-gnd"
BR2_TARGET_GENERIC_ISSUE="fpvOS P1 ground unit (experimental)"
BR2_TARGET_GENERIC_ROOT_PASSWD="root"
# BR2_TARGET_GENERIC_GETTY is not set
BR2_ROOTFS_OVERLAY="$(BR2_EXTERNAL_FPVOS_PATH)/board/common/ar9311/rootfs-overlay $(BR2_EXTERNAL_FPVOS_PATH)/board/p1-gnd/rootfs-overlay"
BR2_LINUX_KERNEL=y
BR2_LINUX_KERNEL_CUSTOM_TARBALL=y
BR2_LINUX_KERNEL_CUSTOM_TARBALL_LOCATION="https://cdn.kernel.org/pub/linux/kernel/v6.x/linux-6.18.36.tar.xz"
BR2_LINUX_KERNEL_PATCH="$(BR2_EXTERNAL_FPVOS_PATH)/board/common/ar9311/linux-patches"
BR2_LINUX_KERNEL_USE_CUSTOM_CONFIG=y
BR2_LINUX_KERNEL_CUSTOM_CONFIG_FILE="$(BR2_EXTERNAL_FPVOS_PATH)/board/common/ar9311/linux.defconfig"
BR2_LINUX_KERNEL_CONFIG_FRAGMENT_FILES="$(BR2_EXTERNAL_FPVOS_PATH)/board/common/ar9311/linux.fragment $(BR2_EXTERNAL_FPVOS_PATH)/board/p1-gnd/linux.fragment"
BR2_LINUX_KERNEL_DTS_SUPPORT=y
BR2_LINUX_KERNEL_CUSTOM_DTS_DIR="$(BR2_EXTERNAL_FPVOS_PATH)/board/common/ar9311/dts $(BR2_EXTERNAL_FPVOS_PATH)/board/p1-goggle/dts $(BR2_EXTERNAL_FPVOS_PATH)/board/p1-nano-vrx/dts $(BR2_EXTERNAL_FPVOS_PATH)/board/p1-gnd/dts"
BR2_PACKAGE_BUSYBOX_CONFIG_FRAGMENT_FILES="$(BR2_EXTERNAL_FPVOS_PATH)/board/common/ar9311/busybox.fragment $(BR2_EXTERNAL_FPVOS_PATH)/board/p1-gnd/busybox.fragment"
BR2_PACKAGE_DOSFSTOOLS=y
BR2_PACKAGE_DOSFSTOOLS_FSCK_FAT=y
BR2_PACKAGE_E2FSPROGS=y
BR2_PACKAGE_MEMTESTER=y
BR2_PACKAGE_DROPBEAR=y
# BR2_PACKAGE_DROPBEAR_CLIENT is not set
BR2_PACKAGE_DROPBEAR_DISABLE_REVERSEDNS=y
BR2_TARGET_ROOTFS_CPIO=y
BR2_TARGET_ROOTFS_CPIO_GZIP=y
BR2_TARGET_ROOTFS_CPIO_UIMAGE=y
# BR2_TARGET_ROOTFS_TAR is not set
BR2_FPVOS_BOARD_P1_GND=y
BR2_PACKAGE_AR9311_MMC=y
BR2_PACKAGE_LIBDRM=y
BR2_PACKAGE_LIBDRM_INSTALL_TESTS=y
BR2_PACKAGE_AR9311_MEDIA_TEST=y
BR2_PACKAGE_KESTREL_NATIVE=y

BR2_PACKAGE_MTD=y
BR2_PACKAGE_AR9311_RADIO=y
BR2_PACKAGE_AR9311_RADIO_CALIBRATION=y
BR2_PACKAGE_OPEN8030_PROFILE="betafpv-p1-goggle.c"
BR2_PACKAGE_OPEN8030_TRANSPORT_SDIO=y
BR2_PACKAGE_OPEN8030_PINS_BEFORE_FACTORY=y
BR2_PACKAGE_OPEN8030_EXPLICIT_IO_DOMAINS=y
BR2_PACKAGE_OPEN8030_FACTORY_OPTIONAL=y
BR2_PACKAGE_OPEN8030_CONFIG="$(BR2_EXTERNAL_FPVOS_PATH)/board/p1-goggle/radio.json"
# The Nano VRX's radio, beside the goggles' (open8030-nano-vrx.img/.json).
BR2_PACKAGE_OPEN8030_EXTRA_PROFILES="nano-vrx:betafpv-p1-nano-vrx.c:$(BR2_EXTERNAL_FPVOS_PATH)/board/p1-nano-vrx/radio.json"

BR2_PACKAGE_AR9311_FIRMWARE=y
BR2_PACKAGE_AR9311_FIRMWARE_P1_GOGGLE_1_0_36=y

BR2_PACKAGE_FPVOS_UPDATE=y
BR2_PACKAGE_FPVOS_UPDATE_P1_GND=y
BR2_PACKAGE_FPVOS_RECOVERY=y
BR2_PACKAGE_HOST_LZ4=y
BR2_ROOTFS_POST_IMAGE_SCRIPT="$(BR2_EXTERNAL_FPVOS_PATH)/board/p1-gnd/post-image.sh"
```

## br-external/configs/p1nanovrx_defconfig
```kconfig
# BETAFPV P1 Nano VRX: fpvOS in NAND bank 0 with independent recovery; stock bank 1 preserved.
BR2_aarch64=y
BR2_TOOLCHAIN_BUILDROOT_MUSL=y
BR2_KERNEL_HEADERS_6_18=y
BR2_STATIC_LIBS=y
BR2_TARGET_GENERIC_HOSTNAME="fpvos-p1-nano-vrx"
BR2_TARGET_GENERIC_ISSUE="fpvOS P1 Nano VRX (experimental)"
BR2_TARGET_GENERIC_ROOT_PASSWD="root"
# BR2_TARGET_GENERIC_GETTY is not set
BR2_ROOTFS_OVERLAY="$(BR2_EXTERNAL_FPVOS_PATH)/board/common/ar9311/rootfs-overlay $(BR2_EXTERNAL_FPVOS_PATH)/board/p1-nano-vrx/rootfs-overlay"
BR2_LINUX_KERNEL=y
BR2_LINUX_KERNEL_CUSTOM_TARBALL=y
BR2_LINUX_KERNEL_CUSTOM_TARBALL_LOCATION="https://cdn.kernel.org/pub/linux/kernel/v6.x/linux-6.18.36.tar.xz"
BR2_LINUX_KERNEL_PATCH="$(BR2_EXTERNAL_FPVOS_PATH)/board/common/ar9311/linux-patches"
BR2_LINUX_KERNEL_USE_CUSTOM_CONFIG=y
BR2_LINUX_KERNEL_CUSTOM_CONFIG_FILE="$(BR2_EXTERNAL_FPVOS_PATH)/board/common/ar9311/linux.defconfig"
BR2_LINUX_KERNEL_CONFIG_FRAGMENT_FILES="$(BR2_EXTERNAL_FPVOS_PATH)/board/common/ar9311/linux.fragment $(BR2_EXTERNAL_FPVOS_PATH)/board/p1-nano-vrx/linux.fragment"
BR2_LINUX_KERNEL_DTS_SUPPORT=y
BR2_LINUX_KERNEL_CUSTOM_DTS_DIR="$(BR2_EXTERNAL_FPVOS_PATH)/board/common/ar9311/dts $(BR2_EXTERNAL_FPVOS_PATH)/board/p1-nano-vrx/dts"
BR2_PACKAGE_BUSYBOX_CONFIG_FRAGMENT_FILES="$(BR2_EXTERNAL_FPVOS_PATH)/board/common/ar9311/busybox.fragment $(BR2_EXTERNAL_FPVOS_PATH)/board/p1-nano-vrx/busybox.fragment"
BR2_PACKAGE_DOSFSTOOLS=y
BR2_PACKAGE_DOSFSTOOLS_FSCK_FAT=y
BR2_PACKAGE_E2FSPROGS=y
BR2_PACKAGE_MEMTESTER=y
BR2_PACKAGE_DROPBEAR=y
# BR2_PACKAGE_DROPBEAR_CLIENT is not set
BR2_PACKAGE_DROPBEAR_DISABLE_REVERSEDNS=y
BR2_TARGET_ROOTFS_CPIO=y
BR2_TARGET_ROOTFS_CPIO_GZIP=y
BR2_TARGET_ROOTFS_CPIO_UIMAGE=y
# BR2_TARGET_ROOTFS_TAR is not set
BR2_FPVOS_BOARD_P1_NANO_VRX=y
BR2_PACKAGE_AR9311_MMC=y
BR2_PACKAGE_LIBDRM=y
BR2_PACKAGE_LIBDRM_INSTALL_TESTS=y
BR2_PACKAGE_AR9311_MEDIA_TEST=y
BR2_PACKAGE_KESTREL_NATIVE=y

BR2_PACKAGE_MTD=y
BR2_PACKAGE_AR9311_RADIO=y
BR2_PACKAGE_AR9311_RADIO_CALIBRATION=y
BR2_PACKAGE_OPEN8030_PROFILE="betafpv-p1-nano-vrx.c"
BR2_PACKAGE_OPEN8030_TRANSPORT_SDIO=y
BR2_PACKAGE_OPEN8030_PINS_BEFORE_FACTORY=y
BR2_PACKAGE_OPEN8030_EXPLICIT_IO_DOMAINS=y
BR2_PACKAGE_OPEN8030_FACTORY_OPTIONAL=y
BR2_PACKAGE_OPEN8030_CONFIG="$(BR2_EXTERNAL_FPVOS_PATH)/board/p1-nano-vrx/radio.json"

BR2_PACKAGE_AR9311_FIRMWARE=y
BR2_PACKAGE_AR9311_FIRMWARE_P1_GOGGLE_1_0_36=y

BR2_PACKAGE_FPVOS_UPDATE=y
BR2_PACKAGE_FPVOS_UPDATE_P1_NANO_VRX=y
BR2_PACKAGE_FPVOS_RECOVERY=y
BR2_PACKAGE_HOST_LZ4=y
BR2_ROOTFS_POST_IMAGE_SCRIPT="$(BR2_EXTERNAL_FPVOS_PATH)/board/p1-nano-vrx/post-image.sh"
```

## br-external/package/air-busybox/Config.in
```kconfig
config BR2_PACKAGE_AIR_BUSYBOX
	bool "air-busybox"
	help
	  A DHCP server for the air unit's USB network (NCM): Buildroot's
	  busybox, statically linked, with udhcpd only, in the app volume
	  (/usrdata/fpv/air/bin/udhcpd). The stock busybox has none.
	  usb_ip.sh starts it once the USB link is switched to network.
```

## br-external/package/ascent-lite-ffs/Config.in
```kconfig
config BR2_PACKAGE_ASCENT_LITE_FFS
	bool "ascent-lite-ffs"
	depends on BR2_LINUX_KERNEL
	help
	  FunctionFS (usb_f_fs.ko) and CDC-NCM (usb_f_ncm.ko) for the
	  Ascent Lite and Lite+, whose stock kernel has the USB gadget's
	  configfs but neither function: the kernel's own f_fs.c and
	  f_ncm.c, built as modules against the image's kernel tree (the
	  stock kernel's version and vermagic). fpvOS_usb's bridge mode
	  loads usb_f_fs.ko; the USB network mode loads usb_f_ncm.ko.
```

## br-external/package/kestrel-native/Config.in
```kconfig
config BR2_PACKAGE_KESTREL_NATIVE
	bool "Kestrel native AR9311 boot runtime"
	depends on BR2_FPVOS_BOARD_ASCENT_VRX || BR2_FPVOS_BOARD_P1_GOGGLE || BR2_FPVOS_BOARD_SKYZONE_STEADYDIGITAL
	help
	  Install a static, read-only Kestrel runtime and boot
	  supervisor.
	  The runtime is built from fpvOS's kestrel-gnd and
	  ar_libre pins by scripts/native-runtime.sh (build.sh runs
	  it), and pinned in runtime.hash: another file fails the
	  build. KESTREL_NATIVE_IMAGE with KESTREL_NATIVE_SHA256=
	  takes a runtime of your own. The firmware package includes
	  the runtime; no host or SD application install is needed.
	  The image's sha256 is always installed as
	  /usr/share/kestrel/runtime.sha256.
```
